## CMakeLists.txt
```
#
# Copyright (c) 2024 Springer Design, Inc.
#
# SPDX-License-Identifier: LicenseRef-Nordic-5-Clause
#
cmake_minimum_required(VERSION 3.20.0)

find_package(Zephyr REQUIRED HINTS $ENV{ZEPHYR_BASE})
project(peripheral_spo2)

# SDI REF OX START
target_sources(app PRIVATE
  src/main.c
  src/PPGRecorder.c
  src/DataFrame.c
  src/battery.c
)
# SDI REF OX END

#zephyr_library_include_directories(.)
zephyr_library_include_directories(${ZEPHYR_BASE}/samples/bluetooth)

# Create a wrapper CMake library that our app can link with
set(maxlib_src_dir   ${CMAKE_CURRENT_SOURCE_DIR}/maxlib)

set(MAXLIB_LIB_DIR     ${maxlib_src_dir}/lib)
#set(MAXLIB_INCLUDE_DIR ${maxlib_src_dir}/include)

add_library(max86171lib STATIC IMPORTED GLOBAL)
#add_dependencies(
#  max86171lib
#  )
set_target_properties(max86171lib PROPERTIES IMPORTED_LOCATION             ${MAXLIB_LIB_DIR}/max86171lib.a)
#set_target_properties(max86171lib PROPERTIES INTERFACE_INCLUDE_DIRECTORIES ${MAXLIB_INCLUDE_DIR})

target_link_libraries(app PUBLIC max86171lib)
```

## prj.conf
```kconfig
#
# Copyright (c) 2023 Springer Design, Inc.
#
#

CONFIG_MAIN_STACK_SIZE=4096
CONFIG_HEAP_MEM_POOL_SIZE=2048
CONFIG_NEWLIB_LIBC=y
CONFIG_NEWLIB_LIBC_FLOAT_PRINTF=y

# Ensure an MCUboot-compatible binary is generated.
CONFIG_BOOTLOADER_MCUBOOT=y

# enable OTA DFU
CONFIG_NCS_SAMPLE_MCUMGR_BT_OTA_DFU=y
CONFIG_NCS_SAMPLE_MCUMGR_BT_OTA_DFU_SPEEDUP=y

# Enable the UART driver
CONFIG_UART_ASYNC_API=y
CONFIG_NRFX_UARTE0=y
CONFIG_SERIAL=y

# enable BLE
CONFIG_BT=y
CONFIG_BT_PERIPHERAL=y
CONFIG_BT_DEVICE_NAME="SDI PPG Recorder"
CONFIG_BT_DEVICE_APPEARANCE=833
CONFIG_BT_MAX_CONN=1
CONFIG_BT_MAX_PAIRED=1

CONFIG_BT_GATT_CLIENT=y

# Enable the NUS service
CONFIG_BT_NUS=y
CONFIG_BT_NUS_SECURITY_ENABLED=n
CONFIG_BT_USER_DATA_LEN_UPDATE=y
CONFIG_BT_BUF_ACL_RX_SIZE=502
CONFIG_BT_BUF_ACL_TX_SIZE=251
CONFIG_BT_CTLR_DATA_LENGTH_MAX=251
CONFIG_BT_L2CAP_TX_MTU=498

#enable Device Information Service
CONFIG_BT_DIS=y
CONFIG_BT_DIS_PNP=n
CONFIG_BT_DIS_MODEL="Pleth Recorder"
CONFIG_BT_DIS_MANUF="Springer Design, Inc."
CONFIG_BT_DIS_SERIAL_NUMBER=y
CONFIG_BT_DIS_FW_REV=y
CONFIG_BT_DIS_HW_REV=y
CONFIG_BT_DIS_SERIAL_NUMBER_STR="SDI4000"
CONFIG_BT_DIS_FW_REV_STR="Firmware V2.00"
CONFIG_BT_DIS_HW_REV_STR="Hardware V3.2"

# Enable bonding
CONFIG_BT_SETTINGS=y
CONFIG_FLASH=y
CONFIG_FLASH_PAGE_LAYOUT=y
CONFIG_FLASH_MAP=y
CONFIG_NVS=y
CONFIG_SETTINGS=y

# This example requires more workqueue stack
CONFIG_SYSTEM_WORKQUEUE_STACK_SIZE=2048

# Make sure printk is printing to the RTT console
CONFIG_CONSOLE=n
CONFIG_UART_CONSOLE=n
CONFIG_NRF_TRACE_PORT=n
CONFIG_STDOUT_CONSOLE=n
CONFIG_RTT_CONSOLE=n
CONFIG_USE_SEGGER_RTT=y
CONFIG_PRINTK=n
CONFIG_LOG_PRINTK=n
CONFIG_LOG_MODE_IMMEDIATE=n

# Config logger
CONFIG_LOG_BACKEND_SHOW_COLOR=n
CONFIG_LOG=n
CONFIG_USE_SEGGER_RTT=y
CONFIG_LOG_BACKEND_RTT=y
CONFIG_LOG_BACKEND_UART=n
CONFIG_MCUBOOT_UTIL_LOG_LEVEL_WRN=n

CONFIG_ASSERT=y
CONFIG_EVENTS=y

CONFIG_GPIO=y
CONFIG_I2C=y
CONFIG_ADC=y
```

## src/main.c
```c
/*
 * Copyright (c) 2018 Nordic Semiconductor ASA
 *
 * SPDX-License-Identifier: LicenseRef-Nordic-5-Clause
 */

/** @file
 *  @brief Nordic UART Bridge Service (NUS) sample
 */
#include "uart_async_adapter.h"

#include <zephyr/bluetooth/hci.h>
#include <sdc_hci_vs.h>

#include <zephyr/types.h>
#include <zephyr/kernel.h>
#include <zephyr/drivers/uart.h>

#include <zephyr/device.h>
#include <zephyr/devicetree.h>
#include <soc.h>

#include <zephyr/bluetooth/bluetooth.h>
#include <zephyr/bluetooth/uuid.h>
#include <zephyr/bluetooth/gatt.h>
#include <zephyr/bluetooth/hci.h>

#include <bluetooth/services/nus.h>

#include <zephyr/settings/settings.h>
#include <zephyr/device.h>
#include <zephyr/drivers/gpio.h>

#include <stdio.h>

#include "DataFrame.h"
#include "battery.h"

#define STACKSIZE 2048
#define PRIORITY 7

#define DEVICE_NAME CONFIG_BT_DEVICE_NAME
#define DEVICE_NAME_LEN	( sizeof( DEVICE_NAME ) - 1 )

#define UART_BUF_SIZE CONFIG_BT_NUS_UART_BUFFER_SIZE
#define UART_WAIT_FOR_BUF_DELAY K_MSEC(50)
#define UART_WAIT_FOR_RX CONFIG_BT_NUS_UART_RX_WAIT_TIME

#define CHRG_CTL_NODE DT_NODELABEL( chrgctl )
#if !DT_NODE_HAS_STATUS(CHRG_CTL_NODE, okay)
#error "Unsupported board: CHRG_CTL_NODE devicetree alias is not defined"
#endif
static const struct gpio_dt_spec g_devChrgCtl = GPIO_DT_SPEC_GET_OR( CHRG_CTL_NODE, gpios, {0} );

#define USB_CON_NODE DT_NODELABEL( usbcon )
#if !DT_NODE_HAS_STATUS(USB_CON_NODE, okay)
#error "Unsupported board: USB_CON_NODE devicetree alias is not defined"
#endif
static const struct gpio_dt_spec g_devUSBCon = GPIO_DT_SPEC_GET_OR( USB_CON_NODE, gpios, {0} );

#define TP8_NODE DT_NODELABEL( testpt8 )
#if !DT_NODE_HAS_STATUS(TP8_NODE, okay)
#error "Unsupported board: TP8_NODE devicetree alias is not defined"
#endif
const struct gpio_dt_spec g_devTestPt8 = GPIO_DT_SPEC_GET_OR( TP8_NODE, gpios, {0} );

#define TP9_NODE DT_NODELABEL( testpt9 )
#if !DT_NODE_HAS_STATUS(TP9_NODE, okay)
#error "Unsupported board: TP9_NODE devicetree alias is not defined"
#endif
const struct gpio_dt_spec g_devTestPt9 = GPIO_DT_SPEC_GET_OR( TP9_NODE, gpios, {0} );

#define TP10_NODE DT_NODELABEL( testpt10 )
#if !DT_NODE_HAS_STATUS(TP10_NODE, okay)
#error "Unsupported board: TP10_NODE devicetree alias is not defined"
#endif
const struct gpio_dt_spec g_devTestPt10 = GPIO_DT_SPEC_GET_OR( TP10_NODE, gpios, {0} );

#define TP11_NODE DT_NODELABEL( testpt11 )
#if !DT_NODE_HAS_STATUS(TP11_NODE, okay)
#error "Unsupported board: TP11_NODE devicetree alias is not defined"
#endif
const struct gpio_dt_spec g_devTestPt11 = GPIO_DT_SPEC_GET_OR( TP11_NODE, gpios, {0} );

static K_SEM_DEFINE( ble_init_ok, 0, 1 );
K_FIFO_DEFINE( fifo_spo2_tx_data );
K_EVENT_DEFINE( max_event );

struct bt_conn *current_conn;

/* Pleth Recorder Custom Service Variables */
#define BT_UUID_PREC_SERVICE_VAL \
	BT_UUID_128_ENCODE(0x5c190000, 0xd5d7, 0x4412, 0xa26c, 0xfacca0784cba)

static struct bt_uuid_128 prec_uuid = BT_UUID_INIT_128( BT_UUID_PREC_SERVICE_VAL );

static ssize_t read_uint8( struct bt_conn *conn,
						   const struct bt_gatt_attr *attr,
						   void *buf,
						   uint16_t len,
						   uint16_t offset )
{
	uint8_t *value = attr->user_data;

	printk( "Read uint8 0x%X %d\n", *value, offset + len );
	return bt_gatt_attr_read( conn,
							  attr,
							  buf,
							  len,
							  offset,
							  value,
							  sizeof( uint8_t ) );
}

static ssize_t write_uint8( struct bt_conn *conn,
							const struct bt_gatt_attr *attr,
							const void *buf,
							uint16_t len,
							uint16_t offset,
							uint8_t flags )
{
	uint8_t *value = attr->user_data;

	printk( "Write uint8 0x%X %d\n", *((uint8_t*)buf), len );
	if( offset + len > sizeof( uint8_t ) )
	{
		return BT_GATT_ERR( BT_ATT_ERR_INVALID_OFFSET );
	}

	*value = *((uint8_t *)buf);

	return len;
}

static ssize_t read_uint16( struct bt_conn *conn,
							const struct bt_gatt_attr *attr,
							void *buf,
							uint16_t len,
							uint16_t offset )
{
	uint16_t *value = attr->user_data;

	printk( "Read uint16 0x%X %d\n", *value, len );
	return bt_gatt_attr_read( conn,
							  attr,
							  buf,
							  len,
							  offset,
							  value,
							  sizeof( uint16_t ) );
}

const struct bt_uuid_128 sdi_PREC_battery = BT_UUID_INIT_128(
	BT_UUID_128_ENCODE(0x5c19a001, 0xd5d7, 0x4412, 0xa26c, 0xfacca0784cba));

uint16_t nBattery;

static const struct bt_uuid_128 sdi_PREC_led1Drv = BT_UUID_INIT_128(
	BT_UUID_128_ENCODE(0x5c19a002, 0xd5d7, 0x4412, 0xa26c, 0xfacca0784cba));

uint8_t nLed1Drv;

static const struct bt_uuid_128 sdi_PREC_led2Drv = BT_UUID_INIT_128(
	BT_UUID_128_ENCODE(0x5c19a003, 0xd5d7, 0x4412, 0xa26c, 0xfacca0784cba));

uint8_t nLed2Drv;

static const struct bt_uuid_128 sdi_PREC_led3Drv = BT_UUID_INIT_128(
	BT_UUID_128_ENCODE(0x5c19a004, 0xd5d7, 0x4412, 0xa26c, 0xfacca0784cba));

uint8_t nLed3Drv;

static const struct bt_uuid_128 sdi_PREC_led4Drv = BT_UUID_INIT_128(
	BT_UUID_128_ENCODE(0x5c19a005, 0xd5d7, 0x4412, 0xa26c, 0xfacca0784cba));

uint8_t nLed4Drv;

static const struct bt_uuid_128 sdi_PREC_led5Drv = BT_UUID_INIT_128(
	BT_UUID_128_ENCODE(0x5c19a006, 0xd5d7, 0x4412, 0xa26c, 0xfacca0784cba));

uint8_t nLed5Drv;

static const struct bt_uuid_128 sdi_PREC_led6Drv = BT_UUID_INIT_128(
	BT_UUID_128_ENCODE(0x5c19a007, 0xd5d7, 0x4412, 0xa26c, 0xfacca0784cba));

uint8_t nLed6Drv;

static const struct bt_uuid_128 sdi_PREC_led7Drv = BT_UUID_INIT_128(
	BT_UUID_128_ENCODE(0x5c19a008, 0xd5d7, 0x4412, 0xa26c, 0xfacca0784cba));

uint8_t nLed7Drv;

static const struct bt_uuid_128 sdi_PREC_led8Drv = BT_UUID_INIT_128(
	BT_UUID_128_ENCODE(0x5c19a009, 0xd5d7, 0x4412, 0xa26c, 0xfacca0784cba));

uint8_t nLed8Drv;

static const struct bt_uuid_128 sdi_PREC_dcDelay = BT_UUID_INIT_128(
	BT_UUID_128_ENCODE(0x5c19a00a, 0xd5d7, 0x4412, 0xa26c, 0xfacca0784cba));

uint8_t nDCDelay = 10;

static const struct bt_uuid_128 sdi_PREC_modDelay = BT_UUID_INIT_128(
	BT_UUID_128_ENCODE(0x5c19a00b, 0xd5d7, 0x4412, 0xa26c, 0xfacca0784cba));

uint8_t nModDelay = 0;

/* PPG Recorder Primary Service Declaration */
BT_GATT_SERVICE_DEFINE( prec_svc,										// Macro defined in gatt.h
	BT_GATT_PRIMARY_SERVICE( &prec_uuid ),

	BT_GATT_CHARACTERISTIC( &sdi_PREC_battery.uuid,
							BT_GATT_CHRC_READ,
							BT_GATT_PERM_READ,
							read_uint16,
							NULL,
							&nBattery ),
	BT_GATT_CHARACTERISTIC( &sdi_PREC_led1Drv.uuid,
							BT_GATT_CHRC_READ | BT_GATT_CHRC_WRITE,
							BT_GATT_PERM_READ | BT_GATT_PERM_WRITE,
							read_uint8,
							write_uint8,
							&nLed1Drv ),
	BT_GATT_CHARACTERISTIC( &sdi_PREC_led2Drv.uuid,
							BT_GATT_CHRC_READ | BT_GATT_CHRC_WRITE,
							BT_GATT_PERM_READ | BT_GATT_PERM_WRITE,
							read_uint8,
							write_uint8,
							&nLed2Drv ),
	BT_GATT_CHARACTERISTIC( &sdi_PREC_led3Drv.uuid,
							BT_GATT_CHRC_READ | BT_GATT_CHRC_WRITE,
							BT_GATT_PERM_READ | BT_GATT_PERM_WRITE,
							read_uint8,
							write_uint8,
							&nLed3Drv ),
	BT_GATT_CHARACTERISTIC( &sdi_PREC_led4Drv.uuid,
							BT_GATT_CHRC_READ | BT_GATT_CHRC_WRITE,
							BT_GATT_PERM_READ | BT_GATT_PERM_WRITE,
							read_uint8,
							write_uint8,
							&nLed4Drv ),
	BT_GATT_CHARACTERISTIC( &sdi_PREC_led5Drv.uuid,
							BT_GATT_CHRC_READ | BT_GATT_CHRC_WRITE,
							BT_GATT_PERM_READ | BT_GATT_PERM_WRITE,
							read_uint8,
							write_uint8,
							&nLed5Drv ),
	BT_GATT_CHARACTERISTIC( &sdi_PREC_led6Drv.uuid,
							BT_GATT_CHRC_READ | BT_GATT_CHRC_WRITE,
							BT_GATT_PERM_READ | BT_GATT_PERM_WRITE,
							read_uint8,
							write_uint8,
							&nLed6Drv ),
	BT_GATT_CHARACTERISTIC( &sdi_PREC_led7Drv.uuid,
							BT_GATT_CHRC_READ | BT_GATT_CHRC_WRITE,
							BT_GATT_PERM_READ | BT_GATT_PERM_WRITE,
							read_uint8,
							write_uint8,
							&nLed7Drv ),
	BT_GATT_CHARACTERISTIC( &sdi_PREC_led8Drv.uuid,
							BT_GATT_CHRC_READ | BT_GATT_CHRC_WRITE,
							BT_GATT_PERM_READ | BT_GATT_PERM_WRITE,
							read_uint8,
							write_uint8,
							&nLed8Drv ),
	BT_GATT_CHARACTERISTIC( &sdi_PREC_dcDelay.uuid,
							BT_GATT_CHRC_READ | BT_GATT_CHRC_WRITE,
							BT_GATT_PERM_READ | BT_GATT_PERM_WRITE,
							read_uint8,
							write_uint8,
							&nDCDelay ),
	BT_GATT_CHARACTERISTIC( &sdi_PREC_modDelay.uuid,
							BT_GATT_CHRC_READ | BT_GATT_CHRC_WRITE,
							BT_GATT_PERM_READ | BT_GATT_PERM_WRITE,
							read_uint8,
							write_uint8,
							&nModDelay ),
);

/* Nordic BLE UART services definitions */
static const struct device *uart = DEVICE_DT_GET( DT_CHOSEN( nordic_nus_uart ) );
static struct k_work_delayable uart_work;

struct uart_data_t
{
	void *fifo_reserved;
	uint8_t data[UART_BUF_SIZE];
	uint16_t len;
};

bool uart_dump;
#define START_UART		0x11			// Ctrl-Q
#define STOP_UART		0x13			// Ctrl-S
char tx_buff[4096];						// UART transmit buffer

static const struct bt_data ad[] =
{
	BT_DATA_BYTES(BT_DATA_FLAGS, (BT_LE_AD_GENERAL | BT_LE_AD_NO_BREDR)),
	BT_DATA(BT_DATA_NAME_COMPLETE, DEVICE_NAME, DEVICE_NAME_LEN),
};

static const struct bt_data sd[] =
{
	BT_DATA_BYTES(BT_DATA_UUID128_ALL, BT_UUID_NUS_VAL),
};

void set_charger( bool enable )
{
	int err;
	
	err = gpio_pin_set_dt( &g_devChrgCtl, (int)enable );		// set pin to match enable flag
	if( err < 0 )
	{
		printk( "Error %d occured setting charger to %d\n", err, (int)enable );
	}
	return;
}

bool fUSBPwrState;

bool check_usb( void )
{
	return fUSBPwrState;
}

extern uint8_t dumpType;

static const struct device *const async_adapter;

static void uart_cb( const struct device *dev, struct uart_event *evt, void *user_data )
{
	ARG_UNUSED( dev );

	static size_t aborted_len;
	struct uart_data_t *buf;
	static uint8_t *aborted_buf;
	static bool disable_req;

	switch( evt->type )
	{
	case UART_TX_DONE:
		printk( "UART_TX_DONE\n" );
		if( (evt->data.tx.len == 0) || (!evt->data.tx.buf) || (evt->data.tx.buf == (const uint8_t *)&tx_buff) )
		{
			return;
		}

		if( aborted_buf )
		{
			buf = CONTAINER_OF( aborted_buf,
								struct uart_data_t,
								data );
			aborted_buf = NULL;
			aborted_len = 0;
		}
		else
		{
			buf = CONTAINER_OF( evt->data.tx.buf,
								struct uart_data_t,
								data );
		}

		k_free( buf );
		break;

	case UART_RX_RDY:
		printk( "UART_RX_RDY\n" );

		if( evt->data.rx.len > 0 )
		{
//			Parse data received
			if( evt->data.rx.len == 1 && evt->data.rx.buf[evt->data.rx.offset] == START_UART )
			{
				set_charger( true );
				uart_dump = true;
				dumpType = 'D';
			}
			else if( evt->data.rx.len == 1 && evt->data.rx.buf[evt->data.rx.offset] == STOP_UART )
			{
				uart_dump = false;
				set_charger( false );
				dumpType = 'X';
			}
			else
				printk( "Received %s from UART\n", &evt->data.rx.buf[0] );
		}

		break;

	case UART_RX_DISABLED:
		printk( "UART_RX_DISABLED\n" );
		disable_req = false;

		buf = k_malloc( sizeof( *buf ) );
		if( buf )
		{
			buf->len = 0;
		}
		else
		{
			printk("Not able to allocate UART receive buffer\n");
			k_work_reschedule( &uart_work, UART_WAIT_FOR_BUF_DELAY );
			return;
		}

		uart_rx_enable( uart, buf->data,
						sizeof( buf->data ),
						UART_WAIT_FOR_RX );
		break;

	case UART_RX_BUF_REQUEST:
		printk( "UART_RX_BUF_REQUEST\n" );
		buf = k_malloc( sizeof( *buf ) );
		if( buf )
		{
			buf->len = 0;
			uart_rx_buf_rsp( uart, buf->data, sizeof( buf->data ) );
		}
		else
		{
			printk( "Not able to allocate UART receive buffer\n" );
		}
		break;

	case UART_RX_BUF_RELEASED:
		printk( "UART_RX_BUF_RELEASED\n" );
		buf = CONTAINER_OF( evt->data.rx_buf.buf,
							struct uart_data_t,
							data );

		k_free( buf );

		break;

	case UART_TX_ABORTED:
		printk( "UART_TX_ABORTED\n" );
		if( !aborted_buf )
		{
			aborted_buf = (uint8_t *)evt->data.tx.buf;
		}

		aborted_len += evt->data.tx.len;
		buf = CONTAINER_OF( aborted_buf,
							struct uart_data_t,
							data );

		uart_tx( uart,
				 &buf->data[aborted_len],
				 buf->len - aborted_len,
				 SYS_FOREVER_MS );

		break;

	default:
		break;
	}
}

static void uart_work_handler( struct k_work *item )
{
	struct uart_data_t *buf;

	buf = k_malloc( sizeof( *buf ) );
	if( buf )
	{
		buf->len = 0;
	}
	else
	{
		printk( "Not able to allocate UART receive buffer\n" );
		k_work_reschedule( &uart_work, UART_WAIT_FOR_BUF_DELAY );
		return;
	}

	uart_rx_enable( uart,
					buf->data,
					sizeof( buf->data ),
					UART_WAIT_FOR_RX );
}

static bool uart_test_async_api( const struct device *dev )
{
	const struct uart_driver_api *api =
			(const struct uart_driver_api *)dev->api;

	return( api->callback_set != NULL );
}

int uart_init(void)
{
	int err;
	int pos;
	struct uart_data_t *rx;
	struct uart_data_t *tx;

	if( !device_is_ready( uart ) )
	{
		return -ENODEV;
	}

	rx = k_malloc( sizeof( *rx ) );
	if( rx )
	{
		rx->len = 0;
	}
	else
	{
		return -ENOMEM;
	}

	k_work_init_delayable( &uart_work, uart_work_handler );

	if( IS_ENABLED( CONFIG_BT_NUS_UART_ASYNC_ADAPTER ) && !uart_test_async_api( uart ) )
	{
		/* Implement API adapter */
		uart_async_adapter_init( async_adapter, uart );
		uart = async_adapter;
	}

	err = uart_callback_set( uart, uart_cb, NULL );
	if( err )
	{
		k_free( rx );
		printk( "Cannot initialize UART callback\n" );
		return err;
	}

	if( IS_ENABLED( CONFIG_UART_LINE_CTRL ) )
	{
		printk( "Wait for DTR\n" );
		while( true )
		{
			uint32_t dtr = 0;

			uart_line_ctrl_get( uart, UART_LINE_CTRL_DTR, &dtr );
			if( dtr )
			{
				break;
			}
			/* Give CPU resources to low priority threads. */
			k_sleep( K_MSEC( 100 ) );
		}
		printk( "DTR set\n" );
		err = uart_line_ctrl_set( uart, UART_LINE_CTRL_DCD, 1 );
		if( err )
		{
			printk( "Failed to set DCD, ret code %d\n", err );
		}
		err = uart_line_ctrl_set( uart, UART_LINE_CTRL_DSR, 1 );
		if( err )
		{
			printk( "Failed to set DSR, ret code %d\n", err );
		}
	}

	tx = k_malloc( sizeof( *tx ) );

	if( tx )
	{
		pos = snprintf( tx->data,
						sizeof( tx->data ),
						"SDI PPG Recorder V2.10\r\n");

		if( (pos < 0) || (pos >= sizeof( tx->data )) )
		{
			k_free(rx);
			k_free(tx);
			printk( "snprintf returned %d\n", pos );
			return -ENOMEM;
		}

		tx->len = pos;
		err = uart_tx( uart,
					tx->data,
					tx->len,
					SYS_FOREVER_MS );
		if( err )
		{
			k_free( rx );
			k_free( tx );
			printk( "Cannot display welcome message (err: %d)\n", err );
			return err;
		}
	}
	else
	{
		k_free( rx );
		return -ENOMEM;
	}

	err = uart_rx_enable( uart,
						  rx->data,
						  sizeof( rx->data ),
						  50 );
	if( err )
	{
		printk( "Cannot enable uart reception (err: %d)\n", err );
		/* Free the rx buffer only because the tx buffer will be handled in the callback */
		k_free(rx);
	}

	return err;
}

extern uint32_t dumpSize;

static void exchange_func( struct bt_conn *conn, uint8_t err, struct bt_gatt_exchange_params *params )
{
	if( !err )
	{
		printk( "MTU exchange done\n" );
		dumpSize = bt_nus_get_mtu( current_conn );
		printk( "MTU size = %d\n", dumpSize );
	}
	else
	{
		printk( "MTU exchange failed (err %d)\n", err);
	}
}

static void connected(struct bt_conn *conn, uint8_t err)
{
	char addr[BT_ADDR_LE_STR_LEN];

	if( err )
	{
		printk( "Connection failed (err %u)\n", err );
		return;
	}

	bt_addr_le_to_str( bt_conn_get_dst( conn ), addr, sizeof( addr ) );
	printk( "Connected %s\n", addr );

	current_conn = bt_conn_ref( conn );

	static struct bt_gatt_exchange_params exchange_params;

	exchange_params.func = exchange_func;
	err = bt_gatt_exchange_mtu( conn, &exchange_params );
	if( err )
	{
		printk( "MTU exchange failed (err %d)\n", err );
	}
	
}

static void disconnected(struct bt_conn *conn, uint8_t reason)
{
	char addr[BT_ADDR_LE_STR_LEN];

	bt_addr_le_to_str( bt_conn_get_dst( conn ), addr, sizeof( addr ) );

	printk( "Disconnected: %s (reason %u)\n", addr, reason );

	if( current_conn )
	{
		bt_conn_unref( current_conn );
		current_conn = NULL;
	}
}

BT_CONN_CB_DEFINE(conn_callbacks) = {
	.connected    = connected,
	.disconnected = disconnected,
};

static void bt_receive_cb( struct bt_conn *conn,
						   const uint8_t *const data,
						   uint16_t len )
{
	char addr[BT_ADDR_LE_STR_LEN] = {0};

	bt_addr_le_to_str( bt_conn_get_dst(conn), addr, ARRAY_SIZE( addr ) );

	if( len == 1 )
		printk("Received %c command from: %s\n", *data, addr);
	else
		printk("Received %d bytes from: %s\n", len, addr);
	
	dumpType = *data;

}

static struct bt_nus_cb nus_cb = {
	.received = bt_receive_cb,
};

static int set_bd_addr(void)
{
	int err = 0;
	struct net_buf *buf;
	sdc_hci_cmd_vs_zephyr_write_bd_addr_t *cmd_params;

	buf = bt_hci_cmd_create( SDC_HCI_OPCODE_CMD_VS_ZEPHYR_WRITE_BD_ADDR, sizeof( *cmd_params ) );
	if( !buf )
	{
		printk( "Could not allocate command buffer\n" );
		return -ENOMEM;
	}

	cmd_params = net_buf_add( buf, sizeof( *cmd_params ) );

	cmd_params->bd_addr[0]= 0xA0;
	cmd_params->bd_addr[1]= 0x0F;
	cmd_params->bd_addr[2]= 0x00;		// == 4000
	cmd_params->bd_addr[3]= 0x55;
	cmd_params->bd_addr[4]= 0xAA;
	cmd_params->bd_addr[5]= 0x55;



    printk( "bt_hci_cmd_send_sync \n" );

	err = bt_hci_cmd_send_sync( SDC_HCI_OPCODE_CMD_VS_ZEPHYR_WRITE_BD_ADDR, buf, NULL );
	printk( "err: %d \n", err );
	if( err )
	{
		printk( "err: %d \n", err );
		return err;
	}

	printk( "Successfully set bd addr \n" );

	return 0;
}

static void usbcon_callback( const struct device *gpiob, struct gpio_callback *cb, uint32_t pins )
{
	if( gpio_pin_get_raw( g_devUSBCon.port, g_devUSBCon.pin ) )
		fUSBPwrState = true;
	else
		fUSBPwrState = false;
}

static struct gpio_callback usbon_cb;

bool USBConInit( void )
{
int ret;

	if( !device_is_ready( g_devUSBCon.port ) )
	{
		printk( "Error: USB Power port %s is not ready\n", g_devUSBCon.port->name );
		return false;
	}

	ret = gpio_pin_configure_dt( &g_devUSBCon, GPIO_INPUT );
	if( ret != 0 )
	{
		printk("Error %d: failed to configure %s pin %d\n",
		       ret, g_devUSBCon.port->name, g_devUSBCon.pin);
		return false;
	}


	ret =  gpio_pin_interrupt_configure_dt( &g_devUSBCon, GPIO_INT_EDGE_BOTH );
	if( ret != 0 )
	{
		printk( "Error %d: failed to configure interrupt on %s pin %d\n",
				ret, g_devUSBCon.port->name, g_devUSBCon.pin );
		return false;
	}

	gpio_init_callback( &usbon_cb, usbcon_callback, BIT( g_devUSBCon.pin ) );
	gpio_add_callback( g_devUSBCon.port, &usbon_cb );

	printk("Set up USB On at %s pin %d\n", g_devUSBCon.port->name, g_devUSBCon.pin);
	if( gpio_pin_get_raw( g_devUSBCon.port, g_devUSBCon.pin ) )
	{
		fUSBPwrState = true;
	}
	else
	{
		fUSBPwrState = false;
	}

	return true;
}

static int GpioInit( void )
{
int ret;

	if( !device_is_ready( g_devChrgCtl.port ) )
	{
		printk( "Error: Charge Control pin %s is not ready\n", g_devChrgCtl.port->name );
		return -1;
	}

	ret = gpio_pin_configure_dt( &g_devChrgCtl, GPIO_OUTPUT_INACTIVE );
	if( ret != 0 )
	{
		printk("Error %d: failed to configure %s pin %d\n",
		       ret, g_devChrgCtl.port->name, g_devChrgCtl.pin);
		return ret;
	}

	printk("Set up Charge Control at %s pin %d\n", g_devChrgCtl.port->name, g_devChrgCtl.pin);

	if( !device_is_ready( g_devTestPt8.port ) )
	{
		printk( "Error: Test Point 8 pin %s is not ready\n", g_devTestPt8.port->name );
		return -1;
	}

	ret = gpio_pin_configure_dt( &g_devTestPt8, GPIO_OUTPUT_INACTIVE );
	if( ret != 0 )
	{
		printk("Error %d: failed to configure %s pin %d\n",
		       ret, g_devTestPt8.port->name, g_devTestPt8.pin);
		return ret;
	}

	printk("Set up Test Point 8 at %s pin %d\n", g_devTestPt8.port->name, g_devTestPt8.pin);

	if( !device_is_ready( g_devTestPt9.port ) )
	{
		printk( "Error: Test Point 9 pin %s is not ready\n", g_devTestPt9.port->name );
		return -1;
	}

	ret = gpio_pin_configure_dt( &g_devTestPt9, GPIO_OUTPUT_INACTIVE );
	if( ret != 0 )
	{
		printk("Error %d: failed to configure %s pin %d\n",
		       ret, g_devTestPt9.port->name, g_devTestPt9.pin);
		return ret;
	}

	printk("Set up Test Point 9 at %s pin %d\n", g_devTestPt9.port->name, g_devTestPt9.pin);

	if( !device_is_ready( g_devTestPt10.port ) )
	{
		printk( "Error: Test Point 10 pin %s is not ready\n", g_devTestPt10.port->name );
		return -1;
	}

	ret = gpio_pin_configure_dt( &g_devTestPt10, GPIO_OUTPUT_INACTIVE );
	if( ret != 0 )
	{
		printk("Error %d: failed to configure %s pin %d\n",
		       ret, g_devTestPt10.port->name, g_devTestPt10.pin);
		return ret;
	}

	printk("Set up Test Point 10 at %s pin %d\n", g_devTestPt10.port->name, g_devTestPt10.pin);

	if( !device_is_ready( g_devTestPt11.port ) )
	{
		printk( "Error: Test Point 11 pin %s is not ready\n", g_devTestPt11.port->name );
		return -1;
	}

	ret = gpio_pin_configure_dt( &g_devTestPt11, GPIO_OUTPUT_INACTIVE );
	if( ret != 0 )
	{
		printk("Error %d: failed to configure %s pin %d\n",
		       ret, g_devTestPt11.port->name, g_devTestPt11.pin);
		return ret;
	}

	printk("Set up Test Point 11 at %s pin %d\n", g_devTestPt11.port->name, g_devTestPt11.pin);

	USBConInit();

	return 0;
}

void error( void )
{
	while( true )
	{
		/* Spin for ever */
		k_sleep( K_MSEC( 1000 ) );
	}
}

extern void PPGRecorder( void );

void main(void)
{
	int err = 0;
	int batt_mV;

	uart_dump = false;
	dumpType = 'X';				// Start by sending nothing

	err = GpioInit();
	if( err )
	{
		error();
	}

	printk( "GPIO initialized.\n" );

	batt_mV = battery_sample();
	printk( "battery voltage = %d\n", batt_mV );

	nLed1Drv = nLed2Drv = nLed3Drv = nLed4Drv = nLed5Drv = nLed6Drv = nLed7Drv = nLed8Drv = 0;

	err = bt_enable( NULL );
	if( err )
	{
		error();
	}

	set_bd_addr();

	if( IS_ENABLED( CONFIG_SETTINGS ) )
	{
		settings_load();
	}

	err = bt_nus_init( &nus_cb );
	if( err )
	{
		printk("Failed to initialize UART service (err: %d)\n", err);
		return;
	}

	err = bt_le_adv_start( BT_LE_ADV_CONN, ad, ARRAY_SIZE(ad), sd, ARRAY_SIZE( sd ) );
	if( err )
	{
		printk( "Advertising failed to start (err %d)\n", err );
		return;
	}

	printk( "Bluetooth initialized.\n" );

	k_sem_give( &ble_init_ok );
	PPGRecorder();
}

extern void format_uart_dump( FIFO_RAW_DATA *buf, char *dest_buf, int dest_len );

void ble_write_thread( void )
{
	int err;
	FIFO_DATA *buf;

	/* Don't go any further until BLE is initialized */
	k_sem_take( &ble_init_ok, K_FOREVER );

	for( ;; )
	{
		/* Wait indefinitely for data to be sent over bluetooth */
		buf = k_fifo_get( &fifo_spo2_tx_data, K_FOREVER );

		if( dumpType == 'X' )
		{
			continue;				// Ignore buffers until app say to send them
		}
		else if( buf->fifoType == 'D' )
		{
			FIFO_RAW_DATA *dbuf = (FIFO_RAW_DATA *)buf;

			if( uart_dump == false )
			{
				if( dbuf->len != MAX_RAW_DATA - 1 )
					printk( "Attempt to send %d BOGUS raw bytes over BLE connection\n", dbuf->len );
				else
				{
//					printk( "Sending %d raw bytes over BLE connection\n", buf->len );
					err = bt_nus_send( NULL, (uint8_t *)&dbuf->data, dbuf->len );
					if( err )
					{
//						printk( "Failed to send data over BLE connection err = %d\n", err );
					}
				}
			}
			else
			{
//				format_uart_raw( dbuf, tx_buff1, sizeof( tx_buff1 ) );
//				uart_tx( uart, tx_buff1, (strlen( tx_buff1 ) / 2), SYS_FOREVER_MS );
				format_uart_dump( dbuf, tx_buff, sizeof( tx_buff ) );
				uart_tx( uart, tx_buff, strlen( tx_buff ), SYS_FOREVER_MS );
			}
		}
	}
}

K_THREAD_DEFINE(ble_write_thread_id, STACKSIZE, ble_write_thread, NULL, NULL,
		NULL, PRIORITY, 0, 0);
```

## src/DataFrame.c
```c
/*
 * Copyright (c) 2024 Springer Design, Inc
 *
 * SPDX-License-Identifier: GPL-2.0-or-later
 */

#include <zephyr/kernel.h>
#include <zephyr/sys/printk.h>
#include <stdio.h>
#include <stdlib.h>
#include <string.h>

//#include "max86171.h"
#include "DataFrame.h"

static uint32_t	DoAverage( uint32_t *src, int size );
static uint32_t	FindPeak( uint32_t *src, int size );
static void AdjustDrives( int whichOnes );


extern struct k_fifo (fifo_spo2_tx_data);
FIFO_RAW_DATA fifoRawData[2];					// 1 second of raw data
int fifoRawIndex;								// Raw data buffer to use
uint32_t dumpSize;								// MTU size for dumping raw data
uint8_t dumpType;								// Flag indicating what type of data to send
												// 'D' = raw, 'X' = nothing
												
uint32_t GFrame[4][FRAMESIZE];					// Raw Green FIFO data buffers
uint32_t IRFrame[4][FRAMESIZE];					// Raw IR FIFO data buffers
uint32_t RFrame[4][FRAMESIZE];					// Raw Red FIFO data buffers
static int buffIndex;							// next frame buffer destination
static int nFrameIndex;							// Current frame buffer
static int GIRRCollected;
static uint32_t signalGreen;					// Green signal target value 
static uint32_t signalIR;						// IR signal target value 
static uint32_t signalRed;						// Red signal target value 

static uint32_t dcIRMeans[MAX_DC_DELAY];		// IR DC of a frame
static int dcIRIn;								// next dcIRMean index
static int dcIROut;								// next dcIRMean index
static int dcIRCount;							// Number of dcIRMeans collected
uint32_t irDC;									// IR DC to report
static double modIRPeaks[MAX_MOD_DELAY];		// peak modulation for a frame
static int modIRIn;								// next modIRPeak index
double irMod;									// IR modulation to report

static uint32_t dcRedMeans[MAX_DC_DELAY];		// Red DC of a frame
static int dcRedIn;								// next dcRedMean index
static int dcRedOut;							// next dcRedMean index
static int dcRedCount;							// Number of dcRedMeans collected
uint32_t redDC;									// Red DC to report
static double modRedPeaks[MAX_MOD_DELAY];		// peak Red modulation for a frame
static int modRedIn;							// next modRedPeak index
double redMod;									// Red modulation to report

extern uint8_t nLed1Drv;
extern uint8_t nLed2Drv;
extern uint8_t nLed3Drv;
extern uint8_t nLed4Drv;
extern uint8_t nLed5Drv;
extern uint8_t nLed6Drv;
extern uint8_t nLed7Drv;
extern uint8_t nLed8Drv;
extern uint8_t nDCDelay;
extern uint8_t nModDelay;

void InitFrames( void )
{
	buffIndex = 0;
	nFrameIndex = 0;
	GIRRCollected = 0;
	signalGreen = DEF_SIGNAL_TARGET;
	signalRed = DEF_SIGNAL_TARGET;
	signalIR = DEF_SIGNAL_TARGET;

	dcIRIn = 0;
	dcIROut = 0;
	dcIRCount = 0;
	irDC = 0;
	modIRIn = 0;
	irMod = 0.0;
	memset( &dcIRMeans[0], 0, sizeof( dcIRMeans ) );

	dcRedIn = 0;
	dcRedOut = 0;
	dcRedCount = 0;
	redDC = 0;
	modRedIn = 0;
	redMod = 0.0;
	memset( &dcRedMeans[0], 0, sizeof( dcRedMeans ) );

	if( nLed1Drv != 0 )
		max86171_set_green( nLed1Drv );
	else
		max86171_set_green( MAX86171_LED_DRV_DEF );

	if( nLed2Drv != 0 )
		max86171_set_red( nLed2Drv );
	else
		max86171_set_red( MAX86171_LED_DRV_DEF );

	if( nLed3Drv != 0 )
		max86171_set_ir( nLed3Drv );
	else
		max86171_set_ir( MAX86171_LED_DRV_DEF );


	fifoRawIndex = 0;
}

void StartFrames( bool start )
{
	int	i, j;
	
	for( i = 0; i < 4; i++ )
	{
		for( j = 0; j < FRAMESIZE; j++ )			// Clear frame buffers
		{
			GFrame[i][j] = 0;
			IRFrame[i][j] = 0;
			RFrame[i][j] = 0;
		}
	}
	buffIndex = 0;
	nFrameIndex = 0;
	GIRRCollected = 0;
	fifoRawIndex = 0;

	max86171_start( start );
}

int GetFIFOFrame( void )
{
	int x, retVal;
	int i, j;

	x = max86171_get_fifo( buffIndex, nFrameIndex );	// Making an assumption that x will always equal 129...

	if( x == -10 )										// Found some bad data in fifo
	{
		printk( "Bad data collected from max86171 fifo\n" );
		return 0;
	}
	else if( x < 0 )									// Measurement overflow occured
	{
		printk( "Overflow data collected %d from max86171 fifo\n", x );
		AdjustDrives( x );
		max86171_sync();
		return 0;
	}
	else if( x == 0 )
	{
		return 0;
	}

	GIRRCollected += x;
//	printk( "Collected %d from max86171 fifo, total = %d\n", x, GIRRCollected );
	
	if( (GIRRCollected % 258) == 0 )
	{
		dcIRMeans[dcIRIn] = DoAverage( &IRFrame[nFrameIndex][0], FRAMESIZE );		// IR DC of a frame
		modIRPeaks[modIRIn] = ((double)((FindPeak( &IRFrame[nFrameIndex][0], FRAMESIZE ) - dcIRMeans[dcIRIn])) / dcIRMeans[dcIRIn]) * 100;		// peak modulation for a frame
		printf( "IR mean = %u, mod = %f\r\n", dcIRMeans[dcIRIn], modIRPeaks[modIRIn] );
		if( nModDelay == 0 )
		{
			irMod = modIRPeaks[modIRIn];		// IR modulation to report
		}
		else
		{
			if( ++modIRIn == nModDelay )
			{
				modIRIn = 0;
				for( i = 0; i < nModDelay; i++ )
				{
					irMod += modIRPeaks[i];
				}
				--i;
				irMod /= i;
			}
		}

		if( ++dcIRIn == MAX_DC_DELAY )
			dcIRIn = 0;
		if( dcIROut )
		{
			j = dcIROut;
			irDC = 0;
			for( i = 0; i < nDCDelay; i++ )
			{
				irDC += dcIRMeans[j];
				if( ++j == MAX_DC_DELAY )
					j = 0;
			}
			irDC /= i;

			if( ++dcIROut == MAX_DC_DELAY )
				dcIROut = 0;
		}

		if( ++dcIRCount == nDCDelay )
		{
			dcIRCount = 0;
			if( dcIROut == 0 )
			{
				++dcIROut;
			}
		}

		dcRedMeans[dcRedIn] = DoAverage( &RFrame[nFrameIndex][0], FRAMESIZE );		// Red DC of a frame
		modRedPeaks[modRedIn] = ((double)((FindPeak( &RFrame[nFrameIndex][0], FRAMESIZE ) - dcRedMeans[dcRedIn])) / dcRedMeans[dcRedIn]) * 100;		// peak modulation for a frame
		printf( "Red mean = %u, mod = %f\r\n", dcRedMeans[dcRedIn], modRedPeaks[modRedIn] );
		if( nModDelay == 0 )
		{
			redMod = modRedPeaks[modRedIn];		// Red modulation to report
		}
		else
		{
			if( ++modRedIn == nModDelay )
			{
				modRedIn = 0;
				for( i = 0; i < nModDelay; i++ )
				{
					redMod += modRedPeaks[i];
				}
				--i;
				redMod /= i;
			}
		}
		if( ++dcRedIn == MAX_DC_DELAY )
			dcRedIn = 0;
		if( dcRedOut )
		{
			j = dcRedOut;
			redDC = 0;
			for( i = 0; i < nDCDelay; i++ )
			{
				redDC += dcRedMeans[j];
				if( ++j == MAX_DC_DELAY )
					j = 0;
			}
			redDC /= i;

			if( ++dcRedOut == MAX_DC_DELAY )
				dcRedOut = 0;
		}

		if( ++dcRedCount == nDCDelay )
		{
			dcRedCount = 0;
			if( dcRedOut == 0 )
			{
				++dcRedOut;
			}
		}
		retVal = nFrameIndex + 1;
		if( ++nFrameIndex == 4 )
			nFrameIndex = 1;
		buffIndex = 0;
		fifoRawIndex = 0;
		if( dumpType == 'D' )
		{
			fifoRawData[1].fifoType = 'D';
			fifoRawData[1].len = MAX_RAW_DATA - 1;
			k_fifo_put( &fifo_spo2_tx_data, &fifoRawData[1] );
		}
	}
	else
	{
		retVal = nFrameIndex;
		buffIndex = x / 3;
		fifoRawIndex = 1;
		if( dumpType == 'D' )
		{
			fifoRawData[0].fifoType = 'D';
			fifoRawData[0].len = MAX_RAW_DATA - 1;
			k_fifo_put( &fifo_spo2_tx_data, &fifoRawData[0] );
		}
	}

	return retVal;
}

int ServoFrame( void )
{
	uint32_t sizeSignal;
	uint32_t sizeLoTarget;
	uint32_t sizeHiTarget;
	uint32_t driveInc;
	uint8_t sizeDrive;
//	double sizeDiff;
	uint8_t sizeAdjust;
	int retVal = 0;

	if( nLed1Drv != 0 )			// has drives been set via Bluetooth?
	{
		if( nLed1Drv != max86171_get_green() )
		{
			max86171_set_green( nLed1Drv );
			++retVal;
		}
	
		if( nLed2Drv != max86171_get_red() )
		{
			max86171_set_red( nLed2Drv );
			++retVal;
		}
	
		if( nLed3Drv != max86171_get_ir() )
		{
			max86171_set_ir( nLed3Drv );
			++retVal;
		}
		return retVal;			// Servo is not done when any LED drive is set via Bluetooth
	}


	sizeSignal = DoAverage( &IRFrame[0][0], FRAMESIZE );
	sizeSignal += DoAverage( &IRFrame[1][0], FRAMESIZE );
	sizeSignal /= 2;
	sizeLoTarget = (signalIR - (signalIR / 5));
	sizeHiTarget = (signalIR + (signalIR / 5));

	printk( "Servo IR, size = %d Lo = %d, Hi = %d\n", sizeSignal, sizeLoTarget, sizeHiTarget );
	if( sizeSignal > MAX86171_PD_MAX || sizeSignal < MAX86171_PD_MIN )	// Do we have a minimum or maximum signal?
	{
//		return 0x7f;				// return nothing to see BUT...
		return retVal;				// don't force a framecount reset
	}
	
	sizeDrive = max86171_get_ir();
	if( sizeSignal < sizeLoTarget )				// real signal below target?
	{
		driveInc = sizeSignal / sizeDrive;
		if( sizeLoTarget - sizeSignal < driveInc )
		{
			sizeAdjust = MAX86171_LED_DRV_INC;
		}
		else
		{
			sizeAdjust = (sizeLoTarget - sizeSignal) / driveInc;
			if( sizeAdjust & 1 )
				++sizeAdjust;
		}
//		sizeDiff = (double)sizeLoTarget / sizeSignal;
//		sizeAdjust = (uint8_t)((double)sizeDrive * sizeDiff);
//		sizeAdjust = ((((sizeSignal * 100) / sizeLoTarget) - 100) * 2);
		printk( "IR up a = %d\n", sizeAdjust );
		
		if( sizeAdjust > MAX86171_LED_DRV_INC && sizeDrive != MAX86171_LED_DRV_MAX )
		{
			if( sizeDrive < MAX86171_LED_DRV_MAX  - sizeAdjust )	// enough head room to use the adjustment?
			{
				sizeDrive += sizeAdjust;
					
				max86171_set_ir( sizeDrive );
				printk( "Small IR, drive = %d\n", sizeDrive );
				++retVal;
			}
			else
			{
				sizeDrive += (MAX86171_LED_DRV_MAX - sizeDrive);
				max86171_set_ir( sizeDrive );
				printk( "Small IR, max drive = %d\n", sizeDrive );
				++retVal;
			}
		}
		else if( sizeDrive < MAX86171_LED_DRV_MAX - MAX86171_LED_DRV_INC )	// at max LED drive level?
		{
			sizeDrive += MAX86171_LED_DRV_INC;

			max86171_set_ir( sizeDrive );
			printk( "Small IR, inc drive = %d\n", sizeDrive );
			++retVal;
		}
		else
		{
//			signalIR = sizeSignal;
			printk( "New < IR, signal = %d\n", sizeSignal );
		}
	}
	else if( sizeSignal > sizeHiTarget )				// real signal above target?
	{
		driveInc = sizeSignal / sizeDrive;
		if( sizeSignal - sizeHiTarget < driveInc )
		{
			sizeAdjust = MAX86171_LED_DRV_INC;
		}
		else
		{
			sizeAdjust = (sizeSignal - sizeHiTarget) / driveInc;
			if( sizeAdjust & 1 )
				++sizeAdjust;
		}
//		sizeDiff = sizeHiTarget / sizeSignal;
//		sizeAdjust = MAX86171_LED_DRV_MAX - (uint8_t)((double)sizeDrive * sizeDiff);
//		sizeAdjust = MAX86171_LED_DRV_MAX - ((((sizeSignal * 100) / sizeHiTarget) - 100) * 2);
		printk( "IR down a = %d\n", sizeAdjust );

		if( sizeAdjust > MAX86171_LED_DRV_INC && sizeDrive != MAX86171_LED_DRV_MIN )
		{
			if( sizeDrive > MAX86171_LED_DRV_MIN + sizeAdjust )		// at minimum LED drive level?
			{
				sizeDrive -= sizeAdjust;
				max86171_set_ir( sizeDrive );
				printk( "Big IR, drive = %d\n", sizeDrive );
				++retVal;
			}
			else
			{
				sizeDrive -= (sizeDrive - MAX86171_LED_DRV_MIN);
				max86171_set_ir( sizeDrive );
				printk( "Big IR, min drive = %d\n", sizeDrive );
				++retVal;
			}
		}
		else if( sizeDrive > MAX86171_LED_DRV_MIN - MAX86171_LED_DRV_INC && sizeDrive != MAX86171_LED_DRV_MIN )		// at minimum LED drive level?
		{
			sizeDrive -= MAX86171_LED_DRV_INC;
				
			max86171_set_ir( sizeDrive );
			printk( "Big IR, inc drive = %d\n", sizeDrive );
			++retVal;
		}
		else
		{
			signalIR = sizeSignal;
			printk( "New > IR, signal = %d\n", sizeSignal );
		}
	}

	sizeSignal = DoAverage( &RFrame[0][0], FRAMESIZE );
	sizeSignal += DoAverage( &RFrame[1][0], FRAMESIZE );
	sizeSignal /= 2;
	sizeLoTarget = (signalRed - (signalRed / 5));
	sizeHiTarget = (signalRed + (signalRed / 5));

	printk( "Servo Red, size = %d Lo = %d, Hi = %d\n", sizeSignal, sizeLoTarget, sizeHiTarget );

	sizeDrive = max86171_get_red();
	if( sizeSignal < sizeLoTarget )				// real signal below target?
	{
		driveInc = sizeSignal / sizeDrive;
		if( sizeLoTarget - sizeSignal < driveInc )
		{
			sizeAdjust = MAX86171_LED_DRV_INC;
		}
		else
		{
			sizeAdjust = (sizeLoTarget - sizeSignal) / driveInc;
			if( sizeAdjust & 1 )
				++sizeAdjust;
		}
//		sizeDiff = sizeLoTarget / sizeSignal;
//		sizeAdjust = (uint8_t)((double)sizeDrive * sizeDiff);
//		sizeAdjust = ((((sizeSignal * 100) / sizeHiTarget) - 100) * 2);
		printk( "RED up a = %d\n", sizeAdjust );

		if( sizeAdjust > MAX86171_LED_DRV_INC && sizeDrive != MAX86171_LED_DRV_MAX )
		{
			if( sizeDrive < MAX86171_LED_DRV_MAX  - sizeAdjust )	// enough head room to use the adjustment?
			{
				sizeDrive += sizeAdjust;
					
				max86171_set_red( sizeDrive );
				printk( "Small RED, drive = %d\n", sizeDrive );
				++retVal;
			}
			else
			{
				sizeDrive += (MAX86171_LED_DRV_MAX - sizeDrive);
				max86171_set_red( sizeDrive );
				printk( "Small RED, max drive = %d\n", sizeDrive );
				++retVal;
			}
		}
		else if( sizeDrive < MAX86171_LED_DRV_MAX - MAX86171_LED_DRV_INC )	// at max LED drive level?
		{
			sizeDrive += MAX86171_LED_DRV_INC;

			max86171_set_red( sizeDrive );
			printk( "Small Red, inc drive = %d\n", sizeDrive );
			++retVal;
		}
		else
		{
//			signalRed = sizeSignal;
			printk( "New < Red, signal = %d\n", sizeSignal );
		}
	}
	else if( sizeSignal > sizeHiTarget )				// real signal above target?
	{
		driveInc = sizeSignal / sizeDrive;
		if( sizeSignal - sizeHiTarget < driveInc )
		{
			sizeAdjust = MAX86171_LED_DRV_INC;
		}
		else
		{
			sizeAdjust = (sizeSignal - sizeHiTarget) / driveInc;
			if( sizeAdjust & 1 )
				++sizeAdjust;
		}
//		sizeDiff = sizeHiTarget / sizeSignal;
//		sizeAdjust = MAX86171_LED_DRV_MAX - (uint8_t)((double)sizeDrive * sizeDiff);
//		sizeAdjust = MAX86171_LED_DRV_MAX - ((((sizeSignal * 100) / sizeHiTarget) - 100) * 2);
		printk( "RED down a = %d\n", sizeAdjust );

		if( sizeAdjust > MAX86171_LED_DRV_INC && sizeDrive != MAX86171_LED_DRV_MIN )
		{
			if( sizeDrive > MAX86171_LED_DRV_MIN + sizeAdjust )		// at minimum LED drive level?
			{
				sizeDrive -= sizeAdjust;
					
				max86171_set_red( sizeDrive );
				printk( "Big Red, drive = %d\n", sizeDrive );
				++retVal;
			}
			else
			{
				sizeDrive -= (sizeDrive - MAX86171_LED_DRV_MIN);
				max86171_set_red( sizeDrive );
				printk( "Big Red, min drive = %d\n", sizeDrive );
				++retVal;
			}
		}
		else if( sizeDrive > MAX86171_LED_DRV_MIN  - MAX86171_LED_DRV_INC && sizeDrive != MAX86171_LED_DRV_MIN )		// at minimum LED drive level?
		{
			sizeDrive -= MAX86171_LED_DRV_INC;
				
			max86171_set_red( sizeDrive );
			printk( "Big Red, inc drive = %d\n", sizeDrive );
			++retVal;
		}
		else
		{
//			signalRed = sizeSignal;
			printk( "New > Red, signal = %d\n", sizeSignal );
		}
	}

	return retVal;
}

static uint32_t	DoAverage( uint32_t *src, int size )
{
	int i;
	uint32_t retVal = 0;
	
	for( i = 0; i < size; i++ )
	{
		retVal += *src++;
	}
	return( retVal / size );
}

static uint32_t	FindPeak( uint32_t *src, int size )
{
	int i;
	uint32_t retVal = 0;
	
	for( i = 0; i < size; i++ )
	{
		if( *src > retVal )
			retVal = *src;
		++src;
	}

	return retVal;
}

static void AdjustDrives( int whichOnes )
{
	uint8_t sizeDrive;

	printk( "Overflow occured, measurements = %d\n", whichOnes );
	switch( whichOnes )
	{
	case -1:		// Just Green
		sizeDrive = max86171_get_green();
		if( sizeDrive > MAX86171_LED_DRV_MIN )		// at minimum LED drive level?
		{
			sizeDrive /= 2;							// We're going to binay search for the best level
			max86171_set_green( sizeDrive );
			printk( "Just Green, overdrive = %d\n", sizeDrive );
		}
		break;

	case -2:		// Just IR
		sizeDrive = max86171_get_ir();
		if( sizeDrive > MAX86171_LED_DRV_MIN )		// at minimum LED drive level?
		{
			sizeDrive /= 2;							// We're going to binay search for the best level
			max86171_set_ir( sizeDrive );
			printk( "Just IR, overdrive = %d\n", sizeDrive );
		}
		break;

	case -3:		// Just Red
		sizeDrive = max86171_get_red();
		if( sizeDrive > MAX86171_LED_DRV_MIN )		// at minimum LED drive level?
		{
			sizeDrive /= 2;							// We're going to binay search for the best level
			max86171_set_red( sizeDrive );
			printk( "Just Red, overdrive = %d\n", sizeDrive );
		}
		break;

	case -4:		// Green and IR
		sizeDrive = max86171_get_green();
		if( sizeDrive > MAX86171_LED_DRV_MIN )		// at minimum LED drive level?
		{
			sizeDrive /= 2;							// We're going to binay search for the best level
			max86171_set_green( sizeDrive );
			printk( "Green and, overdrive = %d\n", sizeDrive );
		}
		sizeDrive = max86171_get_ir();
		if( sizeDrive > MAX86171_LED_DRV_MIN )		// at minimum LED drive level?
		{
			sizeDrive /= 2;							// We're going to binay search for the best level
			max86171_set_ir( sizeDrive );
			printk( "IR, overdrive = %d\n", sizeDrive );
		}
		break;

	case -5:		// Green and Red
		sizeDrive = max86171_get_green();
		if( sizeDrive > MAX86171_LED_DRV_MIN )		// at minimum LED drive level?
		{
			sizeDrive /= 2;							// We're going to binay search for the best level
			max86171_set_green( sizeDrive );
			printk( "Green and, overdrive = %d\n", sizeDrive );
		}
		sizeDrive = max86171_get_red();
		if( sizeDrive > MAX86171_LED_DRV_MIN )		// at minimum LED drive level?
		{
			sizeDrive /= 2;							// We're going to binay search for the best level
			max86171_set_red( sizeDrive );
			printk( "RED, overdrive = %d\n", sizeDrive );
		}
		break;

	case -6:		// IR and Red
		sizeDrive = max86171_get_ir();
		if( sizeDrive > MAX86171_LED_DRV_MIN )		// at minimum LED drive level?
		{
			sizeDrive /= 2;							// We're going to binary search for the best level
			max86171_set_ir( sizeDrive );
			printk( "IR and, overdrive = %d\n", sizeDrive );
		}
		sizeDrive = max86171_get_red();
		if( sizeDrive > MAX86171_LED_DRV_MIN )		// at minimum LED drive level?
		{
			sizeDrive /= 2;							// We're going to binary search for the best level
			max86171_set_red( sizeDrive );
			printk( "RED, overdrive = %d\n", sizeDrive );
		}
		break;

	case -7:		// Green, IR and Red
		sizeDrive = max86171_get_green();
		if( sizeDrive > MAX86171_LED_DRV_MIN )		// at minimum LED drive level?
		{
			sizeDrive /= 2;							// We're going to binary search for the best level
			max86171_set_green( sizeDrive );
			printk( "Green and, overdrive = %d\n", sizeDrive );
		}
		sizeDrive = max86171_get_ir();
		if( sizeDrive > MAX86171_LED_DRV_MIN )		// at minimum LED drive level?
		{
			sizeDrive /= 2;							// We're going to binary search for the best level
			max86171_set_ir( sizeDrive );
			printk( "IR and, overdrive = %d\n", sizeDrive );
		}
		sizeDrive = max86171_get_red();
		if( sizeDrive > MAX86171_LED_DRV_MIN )		// at minimum LED drive level?
		{
			sizeDrive /= 2;							// We're going to binary search for the best level
			max86171_set_red( sizeDrive );
			printk( "RED, overdrive = %d\n", sizeDrive );
		}
		break;

	default:
	}
}
```

## src/DataFrame.h
```c
/*
 * Copyright (c) 2024 Springer Design, Inc
 *
 * SPDX-License-Identifier: GPL-2.0-or-later
 */


extern struct k_event (max_event);
#define MAX_FIFO_EVENT		0x0001
#define MAX_ERROR_EVENT		0x0002
#define MAX_THRESH_EVENT	0x0004
#define MAX_ALL_EVENTS		0x0007

#define NUM_LEDS 3
#define FRAMESIZE 86
#define SERVOCOUNT 2
#define MAX_RAW_DATA 391
#define DEF_SIGNAL_TARGET 262144
#define MAX_DC_DELAY 60
#define MAX_MOD_DELAY 60

typedef struct _FIFO_RAW_DATA
{
	void *fifo_reserved;
	uint8_t fifoType;			// Flag indicating the type of fifo same as dumpType
	uint8_t data[MAX_RAW_DATA];
	uint16_t len;
} FIFO_RAW_DATA;

typedef struct _FIFO_DATA
{
	void *fifo_reserved;
	uint8_t fifoType;			// Flag indicating the type of fifo same as dumpType
} FIFO_DATA;

// DataFrame function prototypes
void InitFrames( void );
void StartFrames( bool start );
int GetFIFOFrame( void );
int ServoFrame( void );

// MAX 86171 driver constants and function prototypes
#define MAX86171_LED_DRV_DEF		0x14			// Default LED drive current
#define MAX86171_LED_DRV_MIN		0x02			// Minimum LED drive current
#define MAX86171_LED_DRV_MAX		0xFF			// Maximum LED drive current
#define MAX86171_LED_DRV_INC		0x04			// Perferred servo time LED current increment

#define MAX86171_PD_MAX				1048000			// Maximum and minimum PD values
#define MAX86171_PD_MIN				1024

#define MAX86171_MASK_FIFO_DATA		0x0FFFFF		// MAX 86171 FIFO data type mask

int max86171_init( void );
int max86171_read_fifo( void );
int max86171_get_fifo( int index, int frame );
int max86171_get_event_count( void );
int max86171_start( bool start );
int max86171_sync( void );
uint8_t max86171_get_green( void );
int max86171_set_green( uint8_t drv );
uint8_t max86171_get_ir( void );
int max86171_set_ir( uint8_t drv );
uint8_t max86171_get_red( void );
int max86171_set_red( uint8_t drv );
```

## src/PPGRecorder.c
```c
/*
 * Copyright (c) 2024 Springer Design, Inc
 *
 * SPDX-License-Identifier: GPL-2.0-or-later
 */


#include <zephyr/types.h>
#include <zephyr/kernel.h>
#include <zephyr/bluetooth/bluetooth.h>

#include <stdio.h>
#include <string.h>

#include "DataFrame.h"
#include "battery.h"

extern void	set_charger( bool enable );
extern bool check_usb( void );
extern int uart_init( void );

extern struct bt_conn *current_conn;
extern bool uart_dump;
extern uint16_t nBattery;

extern uint8_t dumpType;

void PPGRecorder( void )
{
	int err = 0;
	int batt_mV;
	uint32_t MaxEvents;
	int FrameCount;
	bool UARTLive = false;
	int z;

	err = max86171_init();

	printk( "Got %d from max86171 init\n", err );

	if( err != 0 )					// If MAX86171 didn't init properly
	{
		while( true )
		{
			/* Spin for ever */
			k_sleep( K_MSEC( 1000 ) );
		}
	}

	while( 1 )
	{
		while( current_conn == NULL && uart_dump == false )		// Wait for a connection or a uart dump request
		{
			k_sleep( K_SECONDS( 1 ) );
			batt_mV = battery_sample();
			nBattery = (uint16_t)batt_mV;
			if( !UARTLive )
			{
				if( check_usb() )
				{
					set_charger( false );
					err = uart_init();
					if( err )
					{
						while( true )
						{
							/* Spin for ever */
							k_sleep( K_MSEC( 1000 ) );
						}
					}
					UARTLive = true;
					printk( "UART initialized.\n" );
				}
			}
		}

		InitFrames();
		StartFrames( true );
		if( max86171_get_event_count() )
		{
			err = max86171_read_fifo();
		}

		z = 0;
		while( current_conn != NULL || uart_dump == true )		// As long as a connection exists or a uart dumping
		{	
			batt_mV = battery_sample();
			nBattery = (uint16_t)batt_mV;
			MaxEvents = k_event_wait( &max_event, MAX_ALL_EVENTS, true, K_FOREVER );
			if( MaxEvents == MAX_FIFO_EVENT )
			{
				
				err = max86171_read_fifo();
				if( err > 0 && (current_conn != NULL || uart_dump == true) )
				{
					FrameCount = GetFIFOFrame();
					if( FrameCount == SERVOCOUNT )
					{
						z = ServoFrame();
						printk( "Servo returned %d\n", z );
						if( z )
							FrameCount = 0;
					}
					else if( FrameCount == 0 )
					{
						printk( "Frame event but no data available\n" );
					}
					printk( "framecount = %d\n", FrameCount );
				}
			}
		}
		StartFrames( false );		// Stop collecting
		InitFrames();
	}
}

extern uint32_t irDC;
extern double irMod;
extern uint32_t redDC;
extern double redMod;

void format_uart_dump( FIFO_RAW_DATA *buf, char *dest_buf, int dest_len )
{
	uint8_t n;
	uint32_t r;
	uint32_t ir;
	char rdrv[8];
	char irdrv[8];
	char rsig[12];
	char irsig[12];
	char rdc[12];
	char irdc[12];
	char rmod[8];
	char irmod[8];
	int i = 0;

	memset( dest_buf, 0, dest_len );			// Clear destination buffer

	snprintf( rdc, sizeof( rdc ), "%u,", redDC );
	snprintf( irdc, sizeof( irdc ), "%u,", irDC );
	snprintf( rmod, sizeof( rmod ), "%.1f,", redMod );
	snprintf( irmod, sizeof( irmod ), "%.1f\r\n", irMod );
	
	while( i < buf->len )
	{
		if( i == 0 && buf->data[i] == 0xF0 )	// 3 LED drive levels are next
		{
			++i;
			n = buf->data[i];
			snprintf( rdrv, sizeof( rdrv ), "%d,", n );

			++i;
			n = buf->data[i];
			snprintf( irdrv, sizeof( irdrv ), "%d,", n );

			++i;
			++i;			// skip green too
			continue;
		}
		i += 3;
		ir = (uint32_t)((buf->data[i] << 16) | (buf->data[i + 1] << 8) | buf->data[i + 2]);
		snprintf( irsig, sizeof( irsig ), "%u,", (ir & MAX86171_MASK_FIFO_DATA) );
		i += 3;
		r = (uint32_t)((buf->data[i] << 16) | (buf->data[i + 1] << 8) | buf->data[i + 2]);
		snprintf( rsig, sizeof( rsig ), "%u,", (r & MAX86171_MASK_FIFO_DATA) );
		i += 3;
		strcat( dest_buf, rsig );
		strcat( dest_buf, rdrv );
		strcat( dest_buf, rdc );
		strcat( dest_buf, rmod );
		strcat( dest_buf, irsig );
		strcat( dest_buf, irdrv );
		strcat( dest_buf, irdc );
		strcat( dest_buf, irmod );
	};
}
```
